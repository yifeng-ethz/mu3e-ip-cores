# MU3E_BACKPRESSURE_FIFO_WINDOW register map
Vendor: Mu3e; Series: MU3E_FPGA_IP; File version: 1.0.0
CMSIS-SVD description of the 4-word backpressure FIFO status window used in the SciFi datapath bridge. This is a conservative read-only word-window contract.
Registers are 32-bit, read-only, reset 0x0 unless marked. A register's access mark holds for its fields unless they carry their own. Offsets are from the block's base; lines under a group give offsets from that group; [hi:lo] are bit positions; {n}, {i} and the like mark numbered series; 'fields as' and 'values as' point back to an identical list; <NAME> marks a mode.

## Memory map
0x00000000 BACKPRESSURE_FIFO_CSR size 0x10 — Relative 4-word backpressure FIFO status aperture.

## BACKPRESSURE_FIFO_CSR — Relative 4-word backpressure FIFO status aperture.
Base 0x00000000
{0x0+4i} WORD{i:03} (i=0..3) — Backpressure FIFO CSR word {i}.
  [31:0] value — Raw backpressure FIFO CSR word {i}.
