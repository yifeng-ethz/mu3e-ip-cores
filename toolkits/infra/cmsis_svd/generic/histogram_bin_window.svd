# MU3E_HISTOGRAM_BIN_WINDOW register map
Vendor: Mu3e; Series: MU3E_FPGA_IP; File version: 1.0.0
CMSIS-SVD description of the histogram bin memory aperture. This file intentionally models the bin RAM as a read-only register window so the MF stack can expose it in a standard CMSIS-SVD tree while preserving clear separation from the control/status CSR window.
Registers are 32-bit, read-only, reset 0x0 unless marked. A register's access mark holds for its fields unless they carry their own. Offsets are from the block's base; lines under a group give offsets from that group; [hi:lo] are bit positions; {n}, {i} and the like mark numbered series; 'fields as' and 'values as' point back to an identical list; <NAME> marks a mode.

## Memory map
0x00000000 HISTOGRAM_BIN_WINDOW size 0x400 — Relative 256-word histogram bin aperture.

## HISTOGRAM_BIN_WINDOW — Relative 256-word histogram bin aperture.
Base 0x00000000
{0x0+4i} WORD{i:03} (i=0..255) — Histogram bin word {i}.
  [31:0] value — Histogram bin value {i}.
