# MU3E_SCRATCH_PAD_RAM register map
Vendor: Mu3e; Series: MU3E_FPGA_IP; File version: 1.0.0
CMSIS-SVD description of the generic 256-word scratchpad RAM slave window used by Mu3e FEB control paths. BaseAddress is 0 because this file describes the relative window; system integration supplies the live slave base address.
Registers are 32-bit, read-write, reset 0x0 unless marked. A register's access mark holds for its fields unless they carry their own. Offsets are from the block's base; lines under a group give offsets from that group; [hi:lo] are bit positions; {n}, {i} and the like mark numbered series; 'fields as' and 'values as' point back to an identical list; <NAME> marks a mode.

## Memory map
0x00000000 SCRATCH_PAD_RAM size 0x400 — Relative 256-word read/write scratchpad aperture.

## SCRATCH_PAD_RAM — Relative 256-word read/write scratchpad aperture.
Base 0x00000000
{0x0+4i} WORD{i:03} (i=0..255) — Scratchpad RAM word {i}.
  [31:0] value — Raw scratchpad word {i}.
