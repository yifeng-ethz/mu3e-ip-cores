# histogram_snoop_selector register map
File version: 26.1.0.0502
Nonblocking runtime selector between hit-processor and rbCAM histogram snoops.
Registers are 32-bit, read-only, reset 0x0 unless marked. A register's access mark holds for its fields unless they carry their own. Offsets are from the block's base; lines under a group give offsets from that group; [hi:lo] are bit positions; {n}, {i} and the like mark numbered series; 'fields as' and 'values as' point back to an identical list; <NAME> marks a mode.

## Memory map
0x00000000 histogram_snoop_selector size 0x20

## histogram_snoop_selector
Base 0x00000000
0x00 UID rw reset 0x48534E50 — Read ASCII HSNP; any write clears counters.
0x04 META rw reset not defined — Write page select: 0 VERSION, 1 VERSION_DATE, 2 VERSION_GIT, 3 INSTANCE_ID. Read returns selected page.
0x08 CONTROL rw reset 0x2 — Bit 0 selects rbCAM egress. Bit 1 enables rbCAM hit-word filtering. Bit 8 clears counters when written as one.
0x0C STATUS — Live source/filter status, input valids, rbCAM hit-region state, histogram ready/valid, and last rbCAM subheader timestamp.
0x10 HP_SEEN_LO — Low 32 bits of hit-processor snoop valid samples.
0x14 RB_SEEN_LO — Low 32 bits of accepted rbCAM hit-word snoop samples.
0x18 HIST_EMIT_LO — Low 32 bits of selected samples emitted to histogram.
0x1C HIST_DROP_LO — Low 32 bits of selected samples dropped because the histogram was not ready.
