# MU3E_IP_TEMPLATE register map
Vendor: Mu3e; Series: MU3E_FPGA_IP; File version: 0.0.0
Author-owned CMSIS-SVD template for a Mu3e FPGA IP CSR window. Keep this Tcl file as the editable source and regenerate the .svd XML after every register-map change.
Registers are 32-bit, read-only, reset 0x0 unless marked. A register's access mark holds for its fields unless they carry their own. Offsets are from the block's base; lines under a group give offsets from that group; [hi:lo] are bit positions; {n}, {i} and the like mark numbered series; 'fields as' and 'values as' point back to an identical list; <NAME> marks a mode.

## Memory map
0x00000000 IP_TEMPLATE size 0x8 — Relative CSR window. The system integrator supplies the actual slave base address.

## IP_TEMPLATE — Relative CSR window. The system integrator supplies the actual slave base address.
Base 0x00000000
0x00 UID — Software-visible IP identifier. Replace this template text with the author-owned CSR contract.
  [31:0] value — Replace with the real UID field description.
0x04 META rw — Standard Mu3e metadata mux word. Replace page semantics and reset values with the real contract.
  [1:0] page_sel — 0=VERSION, 1=DATE, 2=GIT, 3=INSTANCE_ID by convention.
