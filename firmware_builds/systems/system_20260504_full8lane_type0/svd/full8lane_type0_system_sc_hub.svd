# MU3E_FULL8LANE_TYPE0_SYSTEM_SC_HUB register map
Vendor: Mu3e; Series: MU3E_FULL8LANE_TYPE0; File version: 2026.05.06
Registers are 32-bit, read-write, reset 0x0 unless marked. A register's access mark holds for its fields unless they carry their own. Offsets are from the block's base; [hi:lo] are bit positions; {n}, {i} and the like mark numbered series; 'fields as' and 'values as' point back to an identical list.

## FIREFLY_XCVR_CTRL_0_FIREFLY — Direct control-path slave reached from sc_hub_cmd_pipe.m0. Qsys slave firefly_xcvr_ctrl_0.firefly is SC-hub-relative at 0x00014000 with compiled aperture size 0x00000038. Compiled Qsys module firefly_xcvr_ctrl_0 kind=firefly_xcvr_ctrl version=26.2.423 from full8lane_control_path_subsystem.qsys. Source SVD firefly_xcvr_i2c_master/firefly_xcvr_ctrl.svd version 26.0.330. Relative 14-word Firefly monitor aperture. Read semantics dominate; the first three words also accept control writes described in each register description.
Base 0x00014000
0x00 FF1_TEMP_STATUS — Firefly 1 status/control word. Reads return temperature in bits [7:0]. When hidden CSR mode is enabled, bits [27:24] expose present_n and int_n pins. Writing bit 0 enables or disables continuous I2C polling.
  [31:0] value — Raw 32-bit register word. Refer to the register description for read-versus-write semantics.
0x04 FF1_VCC_RESET — Firefly 1 VCC/control word. Reads return the low 16 bits of the VCC measurement. Writing bit 0 requests a Firefly reset pulse.
  fields as FF1_TEMP_STATUS
0x08 FF1_RXPWR1_HIDDEN — Firefly 1 RX power channel 1 on read. Writing bit 0 enables or disables the hidden CSR page that augments FF1_TEMP_STATUS.
  fields as FF1_TEMP_STATUS
{0x4+4i} FF1_RXPWR{i} ro (i=2..4) — Firefly 1 received optical power for channel {i} in the low 16 bits.
  fields as FF1_TEMP_STATUS
0x18 FF1_ALARM ro — Firefly 1 latched alarm/status flags. Bits clear on read inside the module according to the Firefly alarm semantics.
  fields as FF1_TEMP_STATUS
0x1C FF2_TEMP_STATUS ro — Firefly 2 status word. Reads return temperature in bits [7:0].
  fields as FF1_TEMP_STATUS
0x20 FF2_VCC ro — Firefly 2 VCC measurement in the low 16 bits.
  fields as FF1_TEMP_STATUS
{0x20+4i} FF2_RXPWR{i} ro (i=1..4) — Firefly 2 received optical power for channel {i} in the low 16 bits.
  fields as FF1_TEMP_STATUS
0x34 FF2_ALARM ro — Firefly 2 latched alarm/status flags. Bits clear on read inside the module according to the Firefly alarm semantics.
  fields as FF1_TEMP_STATUS

## ON_DIE_TEMP_SENSE_CTRL_CSR — Direct control-path slave reached from sc_hub_cmd_pipe.m0. Qsys slave on_die_temp_sense_ctrl.csr is SC-hub-relative at 0x00015000 with compiled aperture size 0x00000020. Compiled Qsys module on_die_temp_sense_ctrl kind=altera_temp_sense_ctrl version=1.1 from full8lane_control_path_subsystem.qsys. No source SVD file was present; this peripheral is generated as an explicitly raw window. Intel temperature-sensor control/status window; no local Mu3e SVD source was present.
Base 0x00015000
{0x0+4i} RAW_WORD_{i:02} (i=0..7) — Undecoded raw 32-bit word {i} in on_die_temp_sense_ctrl.csr. The compiled Qsys map exposes this word, but no semantic source SVD was present.
  [31:0] value — Raw 32-bit value for word {i}.

## LEGACY_FIREFLY_BRIDGE_S0 — Direct control-path slave reached from sc_hub_cmd_pipe.m0. Qsys slave legacy_firefly_bridge.s0 is SC-hub-relative at 0x00016000 with compiled aperture size 0x00000400. Compiled Qsys module legacy_firefly_bridge kind=altera_avalon_mm_bridge version=18.1 from full8lane_control_path_subsystem.qsys. No source SVD file was present; this peripheral is generated as an explicitly raw window. Avalon bridge aperture for the legacy Firefly path; the bridge has no decoded local CSR fields.
Base 0x00016000
{0x0+4i} RAW_WORD_{i:02} (i=0..63) — Undecoded raw 32-bit word {i} in legacy_firefly_bridge.s0. The compiled Qsys map exposes this word, but no semantic source SVD was present.
  [31:0] value — Raw 32-bit value for word {i}.

## DATA_PATH_SUBSYSTEM_MUTRIG_RESET_CONTROLLER_0_RECONFIG_MGMT — Datapath-local slave expanded below the SC-hub mm_bridge.s0 aperture. Qsys slave data_path_subsystem_mutrig_reset_controller_0.reconfig_mgmt is SC-hub-relative at 0x00020200 with compiled aperture size 0x00000100. Compiled Qsys module mutrig_reset_controller_0 kind=mutrig_reset_controller version=1.0.8 from full8lane_type0_datapath.qsys. No source SVD file was present; this peripheral is generated as an explicitly raw window. LVDS/MuTRiG reset-controller reconfiguration-management window; no local SVD source was present.
Base 0x00020200
{0x0+4i} RAW_WORD_{i:02} (i=0..63) — Undecoded raw 32-bit word {i} in data_path_subsystem_mutrig_reset_controller_0.reconfig_mgmt. The compiled Qsys map exposes this word, but no semantic source SVD was present.
  [31:0] value — Raw 32-bit value for word {i}.
