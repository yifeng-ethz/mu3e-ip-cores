# MU3E_FULL8LANE_TYPE0_SYSTEM_SC_HUB register map
Vendor: Mu3e; Series: MU3E_FULL8LANE_TYPE0; File version: 2026.05.06
Registers are 32-bit, read-write, reset 0x0 unless marked. A register's access mark holds for its fields unless they carry their own. Offsets are from the block's base; [hi:lo] are bit positions; {n}, {i} and the like mark numbered series.

## DATA_PATH_SUBSYSTEM_HIT_STACK_SUBSYSTEM_1_FEB_FRAME_ASSEMBLY_0_CSR — Datapath-local slave expanded below the SC-hub mm_bridge.s0 aperture. Qsys slave data_path_subsystem_hit_stack_subsystem_1_feb_frame_assembly_0.csr is SC-hub-relative at 0x0002D040 with compiled aperture size 0x00000040. Compiled Qsys module version was not found in the source .qsys files. No source SVD file was present; this peripheral is generated as an explicitly raw window. FEB frame assembly CSR window; no local SVD source was present in this worktree.
Base 0x0002D040
{0x0+4i} RAW_WORD_{i:02} (i=0..15) — Undecoded raw 32-bit word {i} in data_path_subsystem_hit_stack_subsystem_1_feb_frame_assembly_0.csr. The compiled Qsys map exposes this word, but no semantic source SVD was present.
  [31:0] value — Raw 32-bit value for word {i}.

## UPLOAD_SUBSYSTEM_RUNCTL_MGMT_HOST_0_CSR — Upload-subsystem slave expanded below the SC-hub upload_mm_bridge.s0 aperture. Qsys slave upload_subsystem_runctl_mgmt_host_0.csr is SC-hub-relative at 0x00030000 with compiled aperture size 0x00000080. Compiled Qsys module upload_subsystem_runctl_mgmt_host_0 kind=runctl_mgmt_host version=26.2.6.425 from full8lane_type0_system generated HTML/build_full8lane_system.tcl. Version/identity parameters: BUILD_TCL_VERSION=26.3.0.505. Source SVD run-control_mgmt/runctl_mgmt_host.svd version 26.3.0.0505. Relative 21-word CSR aperture for the Run-Control Management Host. The window includes the Mu3e identity header, live status, counters, timestamp snapshots, and the LOCAL_CMD injection port.
Base 0x00030000
0x00 UID ro reset 0x52434D48 — Software-visible IP identifier. Default ASCII "RCMH" (0x52434D48).
0x04 META — Read-multiplexed metadata word. Write page_sel[1:0] before reading back: 0=VERSION, 1=DATE, 2=GIT, 3=INSTANCE_ID.
  [1:0] page_sel — Selects the META read page.
0x08 CONTROL — CSR control register for reset masking, local-log flushing, and software control-path housekeeping.
0x0C STATUS ro — Live run-control receiver, host, upload, and reset state summary.
0x10 LAST_CMD ro — Last accepted command byte plus decoded payload shadow fields.
0x14 SCRATCH — General-purpose scratch register for software bring-up.
0x18 RUN_NUMBER ro — Shadow of the most recently received RUN_PREPARE run number. Synclink payload bytes are decoded in SWB reset-link order: least-significant byte first.
0x1C RESET_MASK ro — Latched reset assert/release mask shadow.
0x20 FPGA_ADDRESS ro — Latched per-FEB address from CMD_ADDRESS or LOCAL_CMD injection.
0x24 RECV_TS_L ro — Low 32 bits of the receive timestamp snapshot.
0x28 RECV_TS_H ro — High 16 bits of the receive timestamp snapshot.
0x2C EXEC_TS_L ro — Low 32 bits of the execute timestamp snapshot.
0x30 EXEC_TS_H ro — High 16 bits of the execute timestamp snapshot.
0x34 GTS_L ro — Low 32 bits of the free-running 48-bit global timestamp snapshot.
0x38 GTS_H ro — High 16 bits of the free-running 48-bit global timestamp snapshot.
0x3C RX_CMD_COUNT ro — Saturating count of accepted run-control commands.
0x40 RX_ERR_COUNT ro — Saturating count of receive-side protocol or decode errors.
0x44 LOG_STATUS ro — Status summary for the internal command log FIFO.
0x48 LOG_POP ro — Read port for the packed 128-bit log FIFO, exposed one 32-bit word at a time.
0x4C LOCAL_CMD — Software injection port for a local run-control command word.
0x50 ACK_SYMBOLS ro — Configured upload acknowledgement symbols for RUN_PREPARE and END_RUN.

## MUTRIG_CFG_CTRL_0_AVMM_CSR — Direct control-path slave reached from sc_hub_cmd_pipe.m0. Qsys slave mutrig_cfg_ctrl_0.avmm_csr is SC-hub-relative at 0x0003F010 with compiled aperture size 0x00000010. Compiled Qsys module mutrig_cfg_ctrl_0 kind=mutrig_cfg_ctrl version=24.1.423 from full8lane_control_path_subsystem.qsys. Source SVD mutrig_controller/mutrig_cfg_ctrl.svd version 24.0.817. Relative 4-word command/status aperture for the MuTRiG controller.
Base 0x0003F010
0x00 OPCODE_STATUS — MuTRiG command/status word. Writes latch a 32-bit opcode. Reads return zero while idle; while busy, bits [31:16] echo opcode[31:16] and bits [15:0] return the controller status word.
  [31:0] value — Raw mixed read/write command and status word.
0x04 OFFSET — Scratchpad/configuration memory offset word used by the MuTRiG controller RPC engine.
  [31:0] value — Raw 32-bit offset word.
0x08 MONITOR_SECONDS — Monitor integration interval in seconds for the MuTRiG controller counter logic.
  [15:0] seconds — Monitor interval in seconds.
0x0C RESERVED3 — Reserved fourth CSR word. Reads return zero. Writes are ignored.
  [31:0] value — Reserved raw word.
