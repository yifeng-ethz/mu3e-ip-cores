# MU3E_FULL8LANE_TYPE0_SYSTEM_SC_HUB register map
Vendor: Mu3e; Series: MU3E_FULL8LANE_TYPE0; File version: 2026.05.06
Registers are 32-bit, read-write, reset 0x0 unless marked. A register's access mark holds for its fields unless they carry their own. Offsets are from the block's base; [hi:lo] are bit positions; {n}, {i} and the like mark numbered series.

## DATA_PATH_SUBSYSTEM_HIT_STACK_SUBSYSTEM_1_RING_BUFFER_CAM_0_CSR — Datapath-local slave expanded below the SC-hub mm_bridge.s0 aperture. Qsys slave data_path_subsystem_hit_stack_subsystem_1_ring_buffer_cam_0.csr is SC-hub-relative at 0x0002B400 with compiled aperture size 0x00000080. Compiled Qsys module version was not found in the source .qsys files. No source SVD file was present; this peripheral is generated as an explicitly raw window. Hit-stack ring-buffer CAM CSR window; no local system-matching SVD source was present in this worktree.
Base 0x0002B400
{0x0+4i} RAW_WORD_{i:02} (i=0..31) — Undecoded raw 32-bit word {i} in data_path_subsystem_hit_stack_subsystem_1_ring_buffer_cam_0.csr. The compiled Qsys map exposes this word, but no semantic source SVD was present.
  [31:0] value — Raw 32-bit value for word {i}.

## DATA_PATH_SUBSYSTEM_HIT_STACK_SUBSYSTEM_1_RING_BUFFER_CAM_1_CSR — Datapath-local slave expanded below the SC-hub mm_bridge.s0 aperture. Qsys slave data_path_subsystem_hit_stack_subsystem_1_ring_buffer_cam_1.csr is SC-hub-relative at 0x0002B480 with compiled aperture size 0x00000080. Compiled Qsys module version was not found in the source .qsys files. No source SVD file was present; this peripheral is generated as an explicitly raw window. Hit-stack ring-buffer CAM CSR window; no local system-matching SVD source was present in this worktree.
Base 0x0002B480
{0x0+4i} RAW_WORD_{i:02} (i=0..31) — Undecoded raw 32-bit word {i} in data_path_subsystem_hit_stack_subsystem_1_ring_buffer_cam_1.csr. The compiled Qsys map exposes this word, but no semantic source SVD was present.
  [31:0] value — Raw 32-bit value for word {i}.

## DATA_PATH_SUBSYSTEM_HIT_STACK_SUBSYSTEM_1_RING_BUFFER_CAM_2_CSR — Datapath-local slave expanded below the SC-hub mm_bridge.s0 aperture. Qsys slave data_path_subsystem_hit_stack_subsystem_1_ring_buffer_cam_2.csr is SC-hub-relative at 0x0002B500 with compiled aperture size 0x00000080. Compiled Qsys module version was not found in the source .qsys files. No source SVD file was present; this peripheral is generated as an explicitly raw window. Hit-stack ring-buffer CAM CSR window; no local system-matching SVD source was present in this worktree.
Base 0x0002B500
{0x0+4i} RAW_WORD_{i:02} (i=0..31) — Undecoded raw 32-bit word {i} in data_path_subsystem_hit_stack_subsystem_1_ring_buffer_cam_2.csr. The compiled Qsys map exposes this word, but no semantic source SVD was present.
  [31:0] value — Raw 32-bit value for word {i}.

## DATA_PATH_SUBSYSTEM_HIT_STACK_SUBSYSTEM_1_RING_BUFFER_CAM_3_CSR — Datapath-local slave expanded below the SC-hub mm_bridge.s0 aperture. Qsys slave data_path_subsystem_hit_stack_subsystem_1_ring_buffer_cam_3.csr is SC-hub-relative at 0x0002B580 with compiled aperture size 0x00000080. Compiled Qsys module version was not found in the source .qsys files. No source SVD file was present; this peripheral is generated as an explicitly raw window. Hit-stack ring-buffer CAM CSR window; no local system-matching SVD source was present in this worktree.
Base 0x0002B580
{0x0+4i} RAW_WORD_{i:02} (i=0..31) — Undecoded raw 32-bit word {i} in data_path_subsystem_hit_stack_subsystem_1_ring_buffer_cam_3.csr. The compiled Qsys map exposes this word, but no semantic source SVD was present.
  [31:0] value — Raw 32-bit value for word {i}.

## DATA_PATH_SUBSYSTEM_HIT_STACK_SUBSYSTEM_0_FEB_FRAME_ASSEMBLY_0_CSR — Datapath-local slave expanded below the SC-hub mm_bridge.s0 aperture. Qsys slave data_path_subsystem_hit_stack_subsystem_0_feb_frame_assembly_0.csr is SC-hub-relative at 0x0002D000 with compiled aperture size 0x00000040. Compiled Qsys module version was not found in the source .qsys files. No source SVD file was present; this peripheral is generated as an explicitly raw window. FEB frame assembly CSR window; no local SVD source was present in this worktree.
Base 0x0002D000
{0x0+4i} RAW_WORD_{i:02} (i=0..15) — Undecoded raw 32-bit word {i} in data_path_subsystem_hit_stack_subsystem_0_feb_frame_assembly_0.csr. The compiled Qsys map exposes this word, but no semantic source SVD was present.
  [31:0] value — Raw 32-bit value for word {i}.
