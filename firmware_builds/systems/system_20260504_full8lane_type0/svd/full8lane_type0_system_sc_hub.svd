# MU3E_FULL8LANE_TYPE0_SYSTEM_SC_HUB register map
Vendor: Mu3e; Series: MU3E_FULL8LANE_TYPE0; File version: 2026.05.06
Grouped CMSIS-SVD for the current full8lane type0 Qsys system. Every peripheral baseAddress is an offset in the SC-hub command address space, i.e. downstream of sc_hub.hub/sc_hub_cmd_pipe.m0. The datapath-local AUTO_AVMM map is expanded below mm_bridge.s0 at 0x00020000, and the upload AUTO_UPLOAD_AVMM map is expanded below upload_mm_bridge.s0 at 0x00030000. The JTAG-side sc_hub.csr aperture is intentionally not listed because it is upstream of the SC-hub command address space. The direct LVDS debug/JTAG master aperture from build_full8lane_system.tcl is not used for these baseAddress values; the SC-hub LVDS CSR base is the datapath-local 0x9000 plus the mm_bridge.s0 base. Run-control note: build Tcl runctl_mgmt_host_readyless_version=26.3.0.505; generated HTML runctl_mgmt_host=26.2.6.425.
Registers are 32-bit, read-write, reset 0x0 unless marked. A register's access mark holds for its fields unless they carry their own. Offsets are from the block's base; lines under a group give offsets from that group; [hi:lo] are bit positions; {n}, {i} and the like mark numbered series; 'fields as' and 'values as' point back to an identical list; <NAME> marks a mode.

## Memory map
0x00000000 SCRATCH_PAD_RAM_S1 size 0x400 — Direct control-path slave reached from sc_hub_cmd_pipe.m0. Qsys slave scratch_pad_ram.s1 is SC-hub-relative at 0x00000000 with compiled aperture size 0x00000400. Compiled Qsys module scratch_pad_ram kind=altera_avalon_onchip_memory2 version=18.1 from full8lane_control_path_subsystem.qsys. Source SVD toolkits/infra/cmsis_svd/generic/scratch_pad_ram.svd version 1.0.0. Relative 256-word read/write scratchpad aperture.
0x00011000 ONEWIRE_MASTER_CONTROLLER_0_CSR size 0x2C — Direct control-path slave reached from sc_hub_cmd_pipe.m0. Qsys slave onewire_master_controller_0.csr is SC-hub-relative at 0x00011000 with compiled aperture size 0x0000002C. Compiled Qsys module onewire_master_controller_0 kind=onewire_master_controller version=26.2.1.428 from full8lane_control_path_subsystem.qsys. Version/identity parameters: VERSION_MAJOR=26, VERSION_MINOR=2, VERSION_PATCH=1, BUILD=428, VERSION_DATE=20260428, VERSION_GIT=0, IP_UID=1331121475, INSTANCE_ID=0. Source SVD onewire_temp_sense/script/onewire_master_controller.svd version 26.2.1. Relative 11-word 1-Wire controller CSR aperture with common Mu3e UID/META header.
0x00012000 MAX10_PROG_AVMM_0_CSR_AVMM size 0x1000 — Direct control-path slave reached from sc_hub_cmd_pipe.m0. Qsys slave max10_prog_avmm_0.csr_avmm is SC-hub-relative at 0x00012000 with compiled aperture size 0x00001000. Compiled Qsys module max10_prog_avmm_0 kind=max10_prog_avmm version=0.2.0 from full8lane_control_path_subsystem.qsys. Version/identity parameters: VERSION_MAJOR=0, VERSION_MINOR=2, VERSION_PATCH=0, BUILD=0. Source SVD feb_max10_comm/legacy/max10_prog_avmm/max10_prog_avmm.svd version 0.2.0. Relative CSR aperture for standard-AVMM MAX10 page programming. The sparse gaps between LAST_ERROR and PAGE_DATA are reserved.
0x00013000 CHARGE_INJECTION_PULSER_0_CSR_AVMM size 0x4 — Direct control-path slave reached from sc_hub_cmd_pipe.m0. Qsys slave charge_injection_pulser_0.csr_avmm is SC-hub-relative at 0x00013000 with compiled aperture size 0x00000004. Compiled Qsys module charge_injection_pulser_0 kind=charge_injection_pulser version=4.0.5 from full8lane_control_path_subsystem.qsys. Source SVD charge_injection/legacy/charge_injection_pulser.svd version 4.0.5. Single-word write-only CSR aperture for charge-injection pulse generation.
0x00014000 FIREFLY_XCVR_CTRL_0_FIREFLY size 0x38 — Direct control-path slave reached from sc_hub_cmd_pipe.m0. Qsys slave firefly_xcvr_ctrl_0.firefly is SC-hub-relative at 0x00014000 with compiled aperture size 0x00000038. Compiled Qsys module firefly_xcvr_ctrl_0 kind=firefly_xcvr_ctrl version=26.2.423 from full8lane_control_path_subsystem.qsys. Source SVD firefly_xcvr_i2c_master/firefly_xcvr_ctrl.svd version 26.0.330. Relative 14-word Firefly monitor aperture. Read semantics dominate; the first three words also accept control writes described in each register description.
0x00015000 ON_DIE_TEMP_SENSE_CTRL_CSR size 0x20 — Direct control-path slave reached from sc_hub_cmd_pipe.m0. Qsys slave on_die_temp_sense_ctrl.csr is SC-hub-relative at 0x00015000 with compiled aperture size 0x00000020. Compiled Qsys module on_die_temp_sense_ctrl kind=altera_temp_sense_ctrl version=1.1 from full8lane_control_path_subsystem.qsys. No source SVD file was present; this peripheral is generated as an explicitly raw window. Intel temperature-sensor control/status window; no local Mu3e SVD source was present.
0x00016000 LEGACY_FIREFLY_BRIDGE_S0 size 0x400 — Direct control-path slave reached from sc_hub_cmd_pipe.m0. Qsys slave legacy_firefly_bridge.s0 is SC-hub-relative at 0x00016000 with compiled aperture size 0x00000400. Compiled Qsys module legacy_firefly_bridge kind=altera_avalon_mm_bridge version=18.1 from full8lane_control_path_subsystem.qsys. No source SVD file was present; this peripheral is generated as an explicitly raw window. Avalon bridge aperture for the legacy Firefly path; the bridge has no decoded local CSR fields.
0x00020200 DATA_PATH_SUBSYSTEM_MUTRIG_RESET_CONTROLLER_0_RECONFIG_MGMT size 0x100 — Datapath-local slave expanded below the SC-hub mm_bridge.s0 aperture. Qsys slave data_path_subsystem_mutrig_reset_controller_0.reconfig_mgmt is SC-hub-relative at 0x00020200 with compiled aperture size 0x00000100. Compiled Qsys module mutrig_reset_controller_0 kind=mutrig_reset_controller version=1.0.8 from full8lane_type0_datapath.qsys. No source SVD file was present; this peripheral is generated as an explicitly raw window. LVDS/MuTRiG reset-controller reconfiguration-management window; no local SVD source was present.
{0x20860+0x1000*n} DATA_PATH_SUBSYSTEM_BACKPRESSURE_FIFO_{n}_CSR size 0x10 (n=0..7) — Datapath-local slave expanded below the SC-hub mm_bridge.s0 aperture. Qsys slave data_path_subsystem_backpressure_fifo_{n}.csr is SC-hub-relative at {0x20860+0x1000*n} with compiled aperture size 0x00000010. Compiled Qsys module backpressure_fifo_{n} kind=altera_avalon_sc_fifo version=18.1 from full8lane_type0_datapath.qsys. Source SVD toolkits/infra/cmsis_svd/generic/backpressure_fifo_window.svd version 1.0.0. Relative 4-word backpressure FIFO status aperture.
{0x20900+0x1000*n} DATA_PATH_SUBSYSTEM_MUTRIG_FRAME_DEASSEMBLY_{n}_CSR size 0x10 (n=0..7) — Datapath-local slave expanded below the SC-hub mm_bridge.s0 aperture. Qsys slave data_path_subsystem_mutrig_frame_deassembly_{n}.csr is SC-hub-relative at {0x20900+0x1000*n} with compiled aperture size 0x00000010. Compiled Qsys module mutrig_frame_deassembly_{n} kind=mutrig_frame_deassembly version=26.0.6.418 from full8lane_type0_datapath.qsys. Version/identity parameters: VERSION_MAJOR=26, VERSION_MINOR=0, VERSION_PATCH=6, BUILD=418, VERSION_DATE=20260418, VERSION_GIT=0, IP_UID=1179804502, INSTANCE_ID=0. Source SVD mutrig_frame_deassembly/script/mutrig_frame_deassembly.svd version 26.0.6.0418. Relative 4-word CSR aperture for MuTRiG frame deassembly.
{0x22000+0x40*n} DATA_PATH_SUBSYSTEM_EMULATOR_MUTRIG_{n}_CSR size 0x40 (n=0..7) — Datapath-local slave expanded below the SC-hub mm_bridge.s0 aperture. Qsys slave data_path_subsystem_emulator_mutrig_{n}.csr is SC-hub-relative at {0x22000+0x40*n} with compiled aperture size 0x00000040. Compiled Qsys module emulator_mutrig_{n} kind=emulator_mutrig version=26.2.0.502 from full8lane_type0_datapath.qsys. Version/identity parameters: VERSION_MAJOR=26, VERSION_MINOR=2, VERSION_PATCH=0, BUILD=502, VERSION_DATE=20260502, VERSION_GIT=179563176, IP_UID=1162696020, INSTANCE_ID=0. Source SVD emulator_mutrig/emulator_mutrig.svd version 26.1.13.0425. Relative 16-word configuration and status window for one emulator instance.
0x00022200 DATA_PATH_SUBSYSTEM_DBG_MM2RUNCTRL_0_CSR size 0x40 — Datapath-local slave expanded below the SC-hub mm_bridge.s0 aperture. Qsys slave data_path_subsystem_dbg_mm2runctrl_0.csr is SC-hub-relative at 0x00022200 with compiled aperture size 0x00000040. Compiled Qsys module dbg_mm2runctrl_0 kind=dbg_mm2runctrl version=1.0.0 from full8lane_type0_datapath.qsys. No source SVD file was present; this peripheral is generated as an explicitly raw window. Debug MM-to-run-control adapter CSR window; no local SVD source was present.
{0x22280+0x80*n} DATA_PATH_SUBSYSTEM_ARB_HIT_TYPE0_SUPERCORE_0_LANE_{n}_CSR size 0x80 (n=0..7) — Datapath-local slave expanded below the SC-hub mm_bridge.s0 aperture. Qsys slave data_path_subsystem_arb_hit_type0_supercore_0_lane_{n}.csr is SC-hub-relative at {0x22280+0x80*n} with compiled aperture size 0x00000080. Compiled Qsys module lane_{n} kind=arb_hit_type0 version=26.4.0.505 from arb_hit_type0_supercore.qsys. Version/identity parameters: VERSION_MAJOR=26, VERSION_MINOR=4, VERSION_PATCH=0, BUILD=505, VERSION_DATE=20260505, VERSION_GIT=0, IP_UID=1095263280, INSTANCE_ID={n}. No source SVD file was present; this peripheral is generated as an explicitly raw window. This peripheral is generated from misc/arb_hit_type0/rtl/arb_hit_type0_csr.sv and the per-lane Qsys child instances in arb_hit_type0_supercore.qsys; no standalone source SVD was present.
0x00024000 DATA_PATH_SUBSYSTEM_MTS_PREPROCESSOR_0_CSR size 0x20 — Datapath-local slave expanded below the SC-hub mm_bridge.s0 aperture. Qsys slave data_path_subsystem_mts_preprocessor_0.csr is SC-hub-relative at 0x00024000 with compiled aperture size 0x00000020. Compiled Qsys module mts_preprocessor_0 kind=mts_preprocessor version=26.0.9.430 from full8lane_type0_datapath.qsys. Version/identity parameters: VERSION_MAJOR=26, VERSION_MINOR=0, VERSION_PATCH=2, BUILD=416, VERSION_DATE=20260416, VERSION_GIT=30068584, IP_UID=1297376080, INSTANCE_ID=0. No source SVD file was present; this peripheral is generated as an explicitly raw window. MTS preprocessor CSR window; no local SVD source was present in this worktree.
0x00028000 DATA_PATH_SUBSYSTEM_MTS_PREPROCESSOR_1_CSR size 0x20 — Datapath-local slave expanded below the SC-hub mm_bridge.s0 aperture. Qsys slave data_path_subsystem_mts_preprocessor_1.csr is SC-hub-relative at 0x00028000 with compiled aperture size 0x00000020. Compiled Qsys module mts_preprocessor_1 kind=mts_preprocessor version=26.0.9.430 from full8lane_type0_datapath.qsys. Version/identity parameters: VERSION_MAJOR=26, VERSION_MINOR=0, VERSION_PATCH=2, BUILD=416, VERSION_DATE=20260416, VERSION_GIT=30068584, IP_UID=1297376080, INSTANCE_ID=0. No source SVD file was present; this peripheral is generated as an explicitly raw window. MTS preprocessor CSR window; no local SVD source was present in this worktree.
0x00029000 DATA_PATH_SUBSYSTEM_LVDS_RX_CONTROLLER_PRO_0_CSR size 0x1000 — Datapath-local slave expanded below the SC-hub mm_bridge.s0 aperture. Qsys slave data_path_subsystem_lvds_rx_controller_pro_0.csr is SC-hub-relative at 0x00029000 with compiled aperture size 0x00001000. Compiled Qsys module lvds_rx_controller_pro_0 kind=mu3e_lvds_controller version=26.2.1.506 from full8lane_type0_datapath.qsys. Version/identity parameters: VERSION_MAJOR=26, VERSION_MINOR=2, VERSION_PATCH=1, BUILD=1286, VERSION_DATE=539362566, VERSION_GIT=0, IP_UID=1280722003, INSTANCE_ID=0, N_LANE=9, N_ENGINE=1, ROUTING_TOPOLOGY=1, SCORE_WINDOW_W=10, SCORE_ACCEPT=8, SCORE_REJECT=2. The Qsys module version is the normalized LVDS IP release; Qsys shows BUILD=1286 and VERSION_DATE=539362566 because the Tcl build supplied hex literals BUILD=0x506 and VERSION_DATE=0x20260506. Standalone source SVD mu3e_lvds_controller/lvds_rx_controller_pro.svd version 26.2.1.0506 is generated from the same current SV RTL map. This system SVD emits the LVDS peripheral directly from mu3e_lvds_controller/rtl/mu3e_lvds_controller.sv so the SC-hub-specific Qsys version and address notes stay local to the grouped map.
0x0002A000 DATA_PATH_SUBSYSTEM_HISTOGRAM_STATISTICS_0_HIST_BIN size 0x400 — Datapath-local slave expanded below the SC-hub mm_bridge.s0 aperture. Qsys slave data_path_subsystem_histogram_statistics_0.hist_bin is SC-hub-relative at 0x0002A000 with compiled aperture size 0x00000400. Compiled Qsys module histogram_statistics_0 kind=full8lane_histogram_statistics_v2 version=26.1.8.502 from full8lane_type0_datapath.qsys. Version/identity parameters: VERSION_MAJOR=26, VERSION_MINOR=1, VERSION_PATCH=8, BUILD=502, VERSION_DATE=20260502, VERSION_GIT=72231161, IP_UID=1212765012, INSTANCE_ID=0. Source SVD toolkits/infra/cmsis_svd/generic/histogram_bin_window.svd version 1.0.0. Relative 256-word histogram bin aperture.
0x0002A400 DATA_PATH_SUBSYSTEM_HISTOGRAM_STATISTICS_0_CSR size 0x80 — Datapath-local slave expanded below the SC-hub mm_bridge.s0 aperture. Qsys slave data_path_subsystem_histogram_statistics_0.csr is SC-hub-relative at 0x0002A400 with compiled aperture size 0x00000080. Compiled Qsys module histogram_statistics_0 kind=full8lane_histogram_statistics_v2 version=26.1.8.502 from full8lane_type0_datapath.qsys. Version/identity parameters: VERSION_MAJOR=26, VERSION_MINOR=1, VERSION_PATCH=8, BUILD=502, VERSION_DATE=20260502, VERSION_GIT=72231161, IP_UID=1212765012, INSTANCE_ID=0. Source SVD histogram_statistics/histogram_statistics.svd version 26.1.6.0429. Relative 19-word CSR aperture for histogram statistics. The separate hist_bin data window is intentionally excluded because it is histogram memory, not control/status registers.
0x0002AC00 DATA_PATH_SUBSYSTEM_HISTOGRAM_INGRESS_BRIDGE_0_CSR size 0x10 — Datapath-local slave expanded below the SC-hub mm_bridge.s0 aperture. Qsys slave data_path_subsystem_histogram_ingress_bridge_0.csr is SC-hub-relative at 0x0002AC00 with compiled aperture size 0x00000010. Compiled Qsys module histogram_ingress_bridge_0 kind=histogram_ingress_bridge version=26.0.5.0506 from full8lane_type0_datapath.qsys. Version/identity parameters: VERSION_MAJOR=26, VERSION_MINOR=0, VERSION_PATCH=5, BUILD=506, VERSION_DATE=20260506, VERSION_GIT=481097348, IP_UID=1212764994, INSTANCE_ID=0. Source SVD histogram_statistics/histogram_ingress_bridge.svd version 26.0.2.0425. Relative 4-word CSR aperture for the histogram ingress selector bridge.
0x0002B000 DATA_PATH_SUBSYSTEM_HIT_STACK_SUBSYSTEM_0_RING_BUFFER_CAM_0_CSR size 0x80 — Datapath-local slave expanded below the SC-hub mm_bridge.s0 aperture. Qsys slave data_path_subsystem_hit_stack_subsystem_0_ring_buffer_cam_0.csr is SC-hub-relative at 0x0002B000 with compiled aperture size 0x00000080. Compiled Qsys module version was not found in the source .qsys files. No source SVD file was present; this peripheral is generated as an explicitly raw window. Hit-stack ring-buffer CAM CSR window; no local system-matching SVD source was present in this worktree.
0x0002B080 DATA_PATH_SUBSYSTEM_HIT_STACK_SUBSYSTEM_0_RING_BUFFER_CAM_1_CSR size 0x80 — Datapath-local slave expanded below the SC-hub mm_bridge.s0 aperture. Qsys slave data_path_subsystem_hit_stack_subsystem_0_ring_buffer_cam_1.csr is SC-hub-relative at 0x0002B080 with compiled aperture size 0x00000080. Compiled Qsys module version was not found in the source .qsys files. No source SVD file was present; this peripheral is generated as an explicitly raw window. Hit-stack ring-buffer CAM CSR window; no local system-matching SVD source was present in this worktree.
0x0002B100 DATA_PATH_SUBSYSTEM_HIT_STACK_SUBSYSTEM_0_RING_BUFFER_CAM_2_CSR size 0x80 — Datapath-local slave expanded below the SC-hub mm_bridge.s0 aperture. Qsys slave data_path_subsystem_hit_stack_subsystem_0_ring_buffer_cam_2.csr is SC-hub-relative at 0x0002B100 with compiled aperture size 0x00000080. Compiled Qsys module version was not found in the source .qsys files. No source SVD file was present; this peripheral is generated as an explicitly raw window. Hit-stack ring-buffer CAM CSR window; no local system-matching SVD source was present in this worktree.
0x0002B180 DATA_PATH_SUBSYSTEM_HIT_STACK_SUBSYSTEM_0_RING_BUFFER_CAM_3_CSR size 0x80 — Datapath-local slave expanded below the SC-hub mm_bridge.s0 aperture. Qsys slave data_path_subsystem_hit_stack_subsystem_0_ring_buffer_cam_3.csr is SC-hub-relative at 0x0002B180 with compiled aperture size 0x00000080. Compiled Qsys module version was not found in the source .qsys files. No source SVD file was present; this peripheral is generated as an explicitly raw window. Hit-stack ring-buffer CAM CSR window; no local system-matching SVD source was present in this worktree.
0x0002B200 DATA_PATH_SUBSYSTEM_MUTRIG_INJECTOR_0_CSR size 0x40 — Datapath-local slave expanded below the SC-hub mm_bridge.s0 aperture. Qsys slave data_path_subsystem_mutrig_injector_0.csr is SC-hub-relative at 0x0002B200 with compiled aperture size 0x00000040. Compiled Qsys module mutrig_injector_0 kind=mutrig_injector_multiheader version=26.0.3.429 from full8lane_type0_datapath.qsys. Version/identity parameters: VERSION_MAJOR=26, VERSION_MINOR=0, VERSION_PATCH=3, BUILD=429, VERSION_DATE=20260429, VERSION_GIT=1385020117, IP_UID=1296649802, INSTANCE_ID=0. Source SVD charge_injection/script/mutrig_injector.svd version 26.0.3.0429. Relative 16-word control/status aperture for the MuTRiG injector.
0x0002B400 DATA_PATH_SUBSYSTEM_HIT_STACK_SUBSYSTEM_1_RING_BUFFER_CAM_0_CSR size 0x80 — Datapath-local slave expanded below the SC-hub mm_bridge.s0 aperture. Qsys slave data_path_subsystem_hit_stack_subsystem_1_ring_buffer_cam_0.csr is SC-hub-relative at 0x0002B400 with compiled aperture size 0x00000080. Compiled Qsys module version was not found in the source .qsys files. No source SVD file was present; this peripheral is generated as an explicitly raw window. Hit-stack ring-buffer CAM CSR window; no local system-matching SVD source was present in this worktree.
0x0002B480 DATA_PATH_SUBSYSTEM_HIT_STACK_SUBSYSTEM_1_RING_BUFFER_CAM_1_CSR size 0x80 — Datapath-local slave expanded below the SC-hub mm_bridge.s0 aperture. Qsys slave data_path_subsystem_hit_stack_subsystem_1_ring_buffer_cam_1.csr is SC-hub-relative at 0x0002B480 with compiled aperture size 0x00000080. Compiled Qsys module version was not found in the source .qsys files. No source SVD file was present; this peripheral is generated as an explicitly raw window. Hit-stack ring-buffer CAM CSR window; no local system-matching SVD source was present in this worktree.
0x0002B500 DATA_PATH_SUBSYSTEM_HIT_STACK_SUBSYSTEM_1_RING_BUFFER_CAM_2_CSR size 0x80 — Datapath-local slave expanded below the SC-hub mm_bridge.s0 aperture. Qsys slave data_path_subsystem_hit_stack_subsystem_1_ring_buffer_cam_2.csr is SC-hub-relative at 0x0002B500 with compiled aperture size 0x00000080. Compiled Qsys module version was not found in the source .qsys files. No source SVD file was present; this peripheral is generated as an explicitly raw window. Hit-stack ring-buffer CAM CSR window; no local system-matching SVD source was present in this worktree.
0x0002B580 DATA_PATH_SUBSYSTEM_HIT_STACK_SUBSYSTEM_1_RING_BUFFER_CAM_3_CSR size 0x80 — Datapath-local slave expanded below the SC-hub mm_bridge.s0 aperture. Qsys slave data_path_subsystem_hit_stack_subsystem_1_ring_buffer_cam_3.csr is SC-hub-relative at 0x0002B580 with compiled aperture size 0x00000080. Compiled Qsys module version was not found in the source .qsys files. No source SVD file was present; this peripheral is generated as an explicitly raw window. Hit-stack ring-buffer CAM CSR window; no local system-matching SVD source was present in this worktree.
0x0002D000 DATA_PATH_SUBSYSTEM_HIT_STACK_SUBSYSTEM_0_FEB_FRAME_ASSEMBLY_0_CSR size 0x40 — Datapath-local slave expanded below the SC-hub mm_bridge.s0 aperture. Qsys slave data_path_subsystem_hit_stack_subsystem_0_feb_frame_assembly_0.csr is SC-hub-relative at 0x0002D000 with compiled aperture size 0x00000040. Compiled Qsys module version was not found in the source .qsys files. No source SVD file was present; this peripheral is generated as an explicitly raw window. FEB frame assembly CSR window; no local SVD source was present in this worktree.
0x0002D040 DATA_PATH_SUBSYSTEM_HIT_STACK_SUBSYSTEM_1_FEB_FRAME_ASSEMBLY_0_CSR size 0x40 — Datapath-local slave expanded below the SC-hub mm_bridge.s0 aperture. Qsys slave data_path_subsystem_hit_stack_subsystem_1_feb_frame_assembly_0.csr is SC-hub-relative at 0x0002D040 with compiled aperture size 0x00000040. Compiled Qsys module version was not found in the source .qsys files. No source SVD file was present; this peripheral is generated as an explicitly raw window. FEB frame assembly CSR window; no local SVD source was present in this worktree.
0x00030000 UPLOAD_SUBSYSTEM_RUNCTL_MGMT_HOST_0_CSR size 0x80 — Upload-subsystem slave expanded below the SC-hub upload_mm_bridge.s0 aperture. Qsys slave upload_subsystem_runctl_mgmt_host_0.csr is SC-hub-relative at 0x00030000 with compiled aperture size 0x00000080. Compiled Qsys module upload_subsystem_runctl_mgmt_host_0 kind=runctl_mgmt_host version=26.2.6.425 from full8lane_type0_system generated HTML/build_full8lane_system.tcl. Version/identity parameters: BUILD_TCL_VERSION=26.3.0.505. Source SVD run-control_mgmt/runctl_mgmt_host.svd version 26.3.0.0505. Relative 21-word CSR aperture for the Run-Control Management Host. The window includes the Mu3e identity header, live status, counters, timestamp snapshots, and the LOCAL_CMD injection port.
0x0003F010 MUTRIG_CFG_CTRL_0_AVMM_CSR size 0x10 — Direct control-path slave reached from sc_hub_cmd_pipe.m0. Qsys slave mutrig_cfg_ctrl_0.avmm_csr is SC-hub-relative at 0x0003F010 with compiled aperture size 0x00000010. Compiled Qsys module mutrig_cfg_ctrl_0 kind=mutrig_cfg_ctrl version=24.1.423 from full8lane_control_path_subsystem.qsys. Source SVD mutrig_controller/mutrig_cfg_ctrl.svd version 24.0.817. Relative 4-word command/status aperture for the MuTRiG controller.
